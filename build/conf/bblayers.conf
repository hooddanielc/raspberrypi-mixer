## build/conf/bblayers.conf
```bitbake
# POKY_BBLAYERS_CONF_VERSION is increased each time build/conf/bblayers.conf
# changes incompatibly
POKY_BBLAYERS_CONF_VERSION = "2"

BBPATH = "${TOPDIR}"
BBFILES ?= ""

BBLAYERS ?= " \
  /data/workspace/tools/poky/meta \
  /data/workspace/tools/poky/meta-poky \
  /data/workspace/tools/poky/meta-yocto-bsp \
  /data/workspace/layers/meta-raspberrypi \
  /data/workspace/layers/meta-openembedded/meta-oe \
  /data/workspace/layers/meta-openembedded/meta-python \
  /data/workspace/layers/meta-openembedded/meta-perl \
  /data/workspace/layers/meta-openembedded/meta-multimedia \
  /data/workspace/layers/meta-openembedded/meta-networking \
  /data/workspace/layers/meta-openembedded/meta-gnome \
  /data/workspace/layers/meta-openembedded/meta-xfce \
  /data/workspace/layers/meta-96boards \
  /data/workspace/layers/meta-qt5 \
  /data/workspace/layers/meta-musicians \
  "
```
